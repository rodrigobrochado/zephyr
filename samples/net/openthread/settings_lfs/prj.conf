## CMakeLists.txt
```
# SPDX-License-Identifier: Apache-2.0

cmake_minimum_required(VERSION 3.20.0)

find_package(Zephyr REQUIRED HINTS $ENV{ZEPHYR_BASE})
project(settings_lfs)

target_sources(app PRIVATE src/main.c)

target_compile_definitions(ot-config INTERFACE "OPENTHREAD_CONFIG_MLE_CHILD_TIMEOUT_DEFAULT=360")
```

## prj.conf
```kconfig
CONFIG_MAIN_STACK_SIZE=4096
CONFIG_INIT_STACKS=y

CONFIG_NETWORKING=y
CONFIG_NET_L2_OPENTHREAD=y
CONFIG_OPENTHREAD_NETWORKKEY="00:11:22:33:44:55:66:77:88:99:aa:bb:cc:dd:ee:ff"
CONFIG_OPENTHREAD_THREAD_STACK_SIZE=8196
CONFIG_OPENTHREAD_NUM_MESSAGE_BUFFERS=256
CONFIG_OPENTHREAD_MAX_CHILDREN=128
# CONFIG_OPENTHREAD_FTD=y
# CONFIG_OPENTHREAD_MTD=y
# CONFIG_OPENTHREAD_MTD_SED=y

CONFIG_FILE_SYSTEM=y
CONFIG_FILE_SYSTEM_LITTLEFS=y

CONFIG_SETTINGS=y
# CONFIG_SETTINGS_NVS=y
# CONFIG_SETTINGS_FS=y

# Logging
CONFIG_LOG=y
CONFIG_LOG_PROCESS_THREAD_STACK_SIZE=2048
CONFIG_LOG_BUFFER_SIZE=2048

CONFIG_USE_SEGGER_RTT=y
CONFIG_RTT_CONSOLE=y
CONFIG_UART_CONSOLE=n
CONFIG_SEGGER_RTT_BUFFER_SIZE_UP=4096

CONFIG_NET_LOG=y
CONFIG_OPENTHREAD_DEBUG=y
CONFIG_OPENTHREAD_LOG_LEVEL_INFO=y
CONFIG_OPENTHREAD_L2_LOG_LEVEL_WRN=y

CONFIG_SETTINGS_LOG_LEVEL_INF=y
```

## src/main.c
```c
/*
 * SPDX-License-Identifier: Apache-2.0
 */

#include <fs/fs.h>
#include <fs/littlefs.h>
#include <net/openthread.h>
#include <openthread/platform/settings.h>

#include <sys/reboot.h>
#include <logging/log_ctrl.h>
#include <logging/log.h>
LOG_MODULE_REGISTER(app_fs);

FS_LITTLEFS_DECLARE_DEFAULT_CONFIG(storage);
static struct fs_mount_t lfs_storage_mnt = {
	.type = FS_LITTLEFS,
	.fs_data = &storage,
	.storage_dev = (void *)FLASH_AREA_ID(storage),
	.mnt_point = "/settings",
};

void mount_fs(void)
{
	int rc;

	rc = fs_mount(&lfs_storage_mnt);
	if (rc < 0) {
		LOG_ERR("FAIL: mount id %u at %s: %d",
		       (unsigned int)lfs_storage_mnt.storage_dev, lfs_storage_mnt.mnt_point,
		       rc);
		return;
	}
}

/*
 * Usage:
 * On child device:
 * west build --board ubx_evkninab3_nrf52840 -- -DCONFIG_OPENTHREAD_MTD=y \
 *			-DCONFIG_OPENTHREAD_MTD_SED=y
 * On router device:
 * west build --board ubx_evkninab3_nrf52840 -- -DCONFIG_OPENTHREAD_FTD=y \
 *			-DCONFIG_SETTINGS_FS=y
 */
void main(void)
{
#if CONFIG_SETTINGS_FS
	struct openthread_context *ot_context = openthread_get_default_context();
	otInstance *ot_instance = ot_context->instance;

    /* manual mount as we are not using automount */
	mount_fs();

	/* running again, as the first one failed */
	otPlatSettingsInit(ot_instance);
#endif
}

void k_sys_fatal_error_handler(unsigned int reason, const z_arch_esf_t *esf)
{
	LOG_PANIC();
	LOG_ERR("Restarting system");

	sys_reboot(SYS_REBOOT_WARM);
}
```
